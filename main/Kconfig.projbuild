## main/Kconfig.projbuild
```kconfig
menu "Remote Control 7"

config APP_ZIGBEE_MINIMAL_TEST
    bool "Run minimal Zigbee pairing diagnostic firmware"
    default y
    help
        Build the simplified Zigbee application used during pairing and
        endpoint diagnostics. The portable OTA component remains attached
        independently through the ota_server submodule.

config APP_ZIGBEE_DEFAULT_CHANNEL
    int "Zigbee default fast-pair channel"
    default 11
    range 11 26
    help
        Channel tried first when there is no previously successful Zigbee
        channel stored in NVS.

config APP_ZIGBEE_FAST_STEERING_ATTEMPTS
    int "Zigbee fast-pair attempts before fallback scan"
    default 3
    range 1 20
    help
        Number of network steering attempts on the last known/default
        channel before falling back to the configured Zigbee channel mask.

config APP_ZIGBEE_SCAN_CHANNEL_MASK
    hex "Zigbee fallback scan channel mask"
    default 0x07FFF800
    help
        Zigbee channel mask used after fast-pair attempts fail. Default
        covers channels 11..26. Example: channel 11 only is 0x00000800.

endmenu
```
